## board/calixto/am335x_versa_nxt512/Kconfig
```kconfig
if TARGET_AM335X_VERSA_NXT512

config SYS_BOARD
	default "am335x_versa_nxt512"

config SYS_VENDOR
	default "calixto"

config SYS_SOC
	default "am33xx"

config SYS_CONFIG_NAME
	default "am335x_versa_nxt512"

config NOR
	bool "Support for NOR flash"
	help
	  The AM335x SoC supports having a NOR flash connected to the GPMC.
	  In practice this is seen as a NOR flash module connected to the
	  "memory cape" for the BeagleBone family.

source "board/ti/common/Kconfig"

endif
```

## board/secure/iec61850_module/Kconfig
```kconfig
if TARGET_AM335X_IEC61850_MODULE

config SYS_BOARD
	default "iec61850_module"

config SYS_VENDOR
	default "secure"

config SYS_SOC
	default "am33xx"

config SYS_CONFIG_NAME
	default "am335x_iec61850_module"

config NOR
	bool "Support for NOR flash"
	help
	  The AM335x SoC supports having a NOR flash connected to the GPMC.
	  In practice this is seen as a NOR flash module connected to the
	  "memory cape" for the BeagleBone family.

source "board/ti/common/Kconfig"

endif
```
